## buildroot-2025.02.16/custom-scripts/lab_defconfig
```kconfig
BR2_TOOLCHAIN_BUILDROOT_GLIBC=y
BR2_TARGET_ENABLE_ROOT_LOGIN=y
BR2_TARGET_GENERIC_ROOT_PASSWD="root"
BR2_TARGET_GENERIC_GETTY_PORT="ttyS0"
BR2_SYSTEM_DHCP=""
# BR2_PACKAGE_HOST_QEMU is not set
BR2_LINUX_KERNEL_CONFIG_FRAGMENT_FILES="custom-scripts/linux.fragment"
BR2_ROOTFS_OVERLAY="overlay"
BR2_ROOTFS_PRE_BUILD_SCRIPT="custom-scripts/pre-build.sh"
BR2_PACKAGE_BUSYBOX_SHOW_OTHERS=y
BR2_PACKAGE_NETCAT_OPENBSD=y
BR2_PACKAGE_BUSYBOX_HTTPD=y
BR2_PACKAGE_KMOD=y
BR2_PACKAGE_KMOD_TOOLS=y
BR2_PACKAGE_HTOP=y
BR2_PACKAGE_PROCPS_NG=y
BR2_PACKAGE_PROCPS_NG_ORIGINAL_TOP=y
```
